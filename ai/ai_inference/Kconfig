## ai/ai_inference/Kconfig
```kconfig
menu "Smart-Air AI Inference"

    config SA_AI_TENSOR_ARENA_SIZE
        int "TFLite Micro tensor arena size (bytes)"
        default 24576
        range 8192 131072
        help
            Static working buffer shared sequentially by both ensemble
            member models (one model's AllocateTensors()/Invoke() fully
            completes before the other's starts, so this only needs to fit
            the LARGER of the two, not both at once).

            24576 (24KB) is a rough starting estimate for this model size
            (~4.5K params, largest INT8 activation ~32 channels x 24
            length) -- NOT a measured value (no ESP32-S3 hardware was
            available to benchmark when this was written, see
            ai/README.md "Benchmark HOWTO"). If `idf.py build` or a boot-time
            log shows `AllocateTensors failed`, increase this value.

endmenu
```

## ai/ai_scheduler/Kconfig
```kconfig
menu "Smart-Air AI Scheduler"

    config SA_AI_ENABLED
        bool "Enable on-device CO/NO2 early warning (publishes ai/state; see SA_AI_CONTROL_RELAY)"
        default n
        help
            Strictly opt-in for the first hardware bring-up (see
            ai/gas_ews/README.md). When disabled, ai_scheduler_start() is a
            no-op: no task is created, no relay/buzzer/MQTT calls are ever
            made. sensor_task still feeds gas_ews (a few float ops per poll).

    config SA_AI_CONTROL_RELAY
        bool "Let the AI switch the Fan relay and buzzer (otherwise observe-only)"
        depends on SA_AI_ENABLED
        default n
        help
            When disabled (default), the AI only publishes
            device/{id}/ai/state and never touches the relay or buzzer.
            Calibrate the GM702B/GM102B first (preheat >= 24h, then
            calibrate_co / calibrate_no2): an uncalibrated GM102B reads ~2 ppm
            NO2 in clean air, close to the QCVN STEL of 5.3 ppm. Run
            observe-only for a few days and check ai/state before enabling.

            When enabled, the AI only ever switches OFF a Fan it switched ON
            itself -- a Fan switched on by a user is never switched off by
            the AI. Buzzer: 3 short beeps on early warning, 5 long beeps
            when a QCVN limit is exceeded.

    config SA_AI_FAN_ON_LEVEL
        int "Switch the Fan on from this level (1 = early warning, 2 = limit exceeded)"
        depends on SA_AI_CONTROL_RELAY
        default 1
        range 1 2
        help
            1: ventilate as soon as the early warning predicts a QCVN STEL
            exceedance within 10 minutes (earlier, more Fan runtime).
            2: only once STEL or TWA is actually over the limit.

    config SA_AI_FAN_RELAY_CHANNEL
        int "Relay channel the AI controls (1-based)"
        depends on SA_AI_ENABLED
        default 1
        range 1 3
        help
            Per the app's own channel labeling (relay_1=Fan, relay_2=Lamp,
            relay_3=Filter -- see app/lib/screens/devices/
            device_dashboard_screen.dart), the AI should control the Fan
            channel (default 1). Only ONE channel is ever touched by AI.

    config SA_AI_OVERRIDE_COOLDOWN_MIN
        int "Minutes to back off after an external relay change (minutes)"
        depends on SA_AI_ENABLED
        default 30
        range 1 240
        help
            Whenever a Fan the AI switched on is found switched off
            (detected by polling relay_get_all(), no changes to
            relay.c/mqtt.c needed), the AI scheduler assumes a human (app
            tap) or another controller just took over, and stays hands-off
            on that channel for this many minutes before resuming automatic
            control. device_mode OFF is not counted as an override.

endmenu
```

## ai/gas_ews/Kconfig
```kconfig
menu "Smart-Air Gas Early Warning (QCVN 03:2019/BYT)"

    config SA_GAS_EWS_ARENA_SIZE
        int "TFLite Micro tensor arena for the gas_ews model (bytes)"
        default 16384
        range 4096 131072
        help
            Largest INT8 activation is 90x16 (1.4 KB); 16 KB is a safe
            first guess, NOT a measurement. The boot log prints
            "arena used X/Y B" -- trim to X plus some margin, or raise it if
            you see "AllocateTensors failed".

endmenu
```

## firmware/components/ai/Kconfig
```kconfig
menu "Smart-Air AI"
    depends on SA_ENABLE_AI

    config SA_AI_TENSOR_ARENA_SIZE
        int "TFLite Micro tensor arena size (bytes)"
        default 24576
        range 8192 262144
        help
            Working buffer for the TFLite Micro interpreter, allocated once
            at boot from PSRAM (MALLOC_CAP_SPIRAM). The boot log prints the
            arena bytes actually used after AllocateTensors(); if it reports
            "AllocateTensors failed", increase this value.

    config SA_AI_WINDOW_BUCKET_SEC
        int "Seconds per window slot (3600 = 1 hour, production)"
        default 3600
        range 5 3600
        help
            The model is trained on 24 consecutive HOURLY means, so keep
            3600 for real use. Lowering it (e.g. 10 with the demo preset)
            fills the 24-slot window in minutes, which is only meant for
            bench-testing the alert path (buzzer + MQTT) end to end.

    config SA_AI_SELF_TEST
        bool "Run model self-test vectors at boot"
        default n
        help
            Runs the known windows in src/ai_selftest_vectors.h through the
            model once at boot and logs PASS/FAIL against the expected
            results. Regenerate that file with tools/gen_selftest_vectors.py.

endmenu
```
